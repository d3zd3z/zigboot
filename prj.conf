## CMakeLists.txt
```
# SPDX-License-Identifier: Apache-2.0

# Build a Zig project as an external project.  The build is done using
# zig build-obj, which will build the project into a single object
# file containing the entire Zig part of the program.  We then
# incorporate that into the Zephyr build.  Main is implemented in Zig.

cmake_minimum_required(VERSION 3.13.1)

find_package(Zephyr REQUIRED HINTS $ENV{ZEPHYR_BASE})

# zephyr_library_import(standalone
#      /home/davidb/linaro/embed-rust/target/thumbv7m-none-eabi/release/libstandalone.a)

project(hello_world)

target_sources(app PRIVATE src/empty.c)
# target_link_libraries(app
#     /home/davidb/linaro/embed-rust/target/thumbv7m-none-eabi/release/libstandalone.a)
# target_link_libraries(app standalone)

include(ExternalProject)

set(standalone_src_dir ${CMAKE_CURRENT_SOURCE_DIR})
set(standalone_build_dir ${standalone_src_dir})

ExternalProject_Add(
    standalone_project
    PREFIX ${standalone_build_dir}
    SOURCE_DIR ${standalone_src_dir}
    BINARY_DIR ${standalone_src_dir}
    CONFIGURE_COMMAND ""
    BUILD_COMMAND "zig" "build-obj"
      # "-OReleaseSmall"
      "-ODebug"
      "-target" "arm-freestanding-eabi" "-mcpu" "cortex_m33" "main.zig"
    INSTALL_COMMAND ""
    BUILD_ALWAYS True
    BUILD_BYPRODUCTS
      ${standalone_build_dir}/main.o)

add_library(standalone_lib STATIC IMPORTED GLOBAL)

# Skip the dependency for now, since the build environment is very
# different.
add_dependencies(
    standalone_lib
    standalone_project
    )
set_target_properties(standalone_lib PROPERTIES IMPORTED_LOCATION
    ${standalone_build_dir}/main.o)

target_link_libraries(app PUBLIC standalone_lib)
```

## prj.conf
```kconfig
# nothing here
CONFIG_CONSOLE_SUBSYS=y
CONFIG_CONSOLE=y
CONFIG_UART_CONSOLE=y
CONFIG_CONSOLE_GETCHAR=y

# Try newlib to get putchar.
# CONFIG_NEWLIB_LIBC=y

CONFIG_PM=n
CONFIG_FLASH=y
CONFIG_FLASH_MAP=y
CONFIG_CBPRINTF_NANO=y

CONFIG_LOG=y

# For debugging
CONFIG_DEBUG=y

CONFIG_MAIN_STACK_SIZE=10240
```

## src/empty.c
```c
// SPDX-License-Identifier: Apache-2.0
/*
 * The Zephyr build system demands a source file in this directory.
 * This file can be used for C interface stubs as they are needed.
 */

#include <zephyr.h>
#include <drivers/timer/system_timer.h>
#include <string.h>

#define LOG_LEVEL LOG_LEVEL_INF
#include <logging/log.h>
#include <logging/log_ctrl.h>
LOG_MODULE_REGISTER(zigboot);

uint64_t uptime_ticks(void) {
	return k_uptime_get();
}

void zig_log_message(int level, const char *msg)
{
	switch (level) {
	case 0:
		LOG_ERR("%s", msg);
		break;
	case 1:
		LOG_WRN("%s", msg);
		break;
	case 2:
		LOG_INF("%s", msg);
		break;
	default:
		LOG_DBG("%s", msg);
	}

	// TODO: Perhaps have another thread do this?
	while (log_process(false)) {
	}
}

void extra(void)
{
	log_init();
	LOG_ERR("Initializatin of logging");
}

/*
 * Zig builds with LLVM, whereas Zephyr is built with GCC.  As such,
 * we may need to implement some of its expected functions.
 */

/* Note that the arguments are in a different order than memset. */
void *__aeabi_memset(void *data, size_t n, int c)
{
	return memset(data, c, n);
}

/* Not sure what this is about.  Perhaps this should be an alias. */
void *__aeabi_memset4(void *data, size_t n, int c)
{
	return memset(data, c, n);
}

/* Not sure what this is about.  Perhaps this should be an alias. */
void *__aeabi_memset8(void *data, size_t n, int c)
{
	return memset(data, c, n);
}

void __aeabi_memcpy(void *dest, const void *src, size_t n)
{
	memcpy(dest, src, n);
}

void __aeabi_memclr(void *dest, size_t n)
{
	memset(dest, 0, n);
}

void __aeabi_memclr8(void *dest, size_t n)
{
	memset(dest, 0, n);
}

/*
 * Chain jump to the next image from the bootloader.
 */
void chain_jump(uint32_t vt, uint32_t msp, uint32_t pc)
{
	/* The Zig code doesn't know the FLASH_BASE, so add that the
	 * vt.  The other values came from the image and are already
	 * adjusted.
	 */
	vt += FLASH_BASE;

	sys_clock_disable();

#ifdef CONFIG_USB_DEVICE_STACK
	/* Disable the USB to prevent it from firing interrupts */
	usb_disable();
#endif
#if CONFIG_MCUBOOT_CLEANUP_ARM_CORE
	cleanup_arm_nvic(); /* cleanup NVIC registers */

#ifdef CONFIG_CPU_CORTEX_M7
	/* Disable instruction cache and data cache before chain-load the application */
	SCB_DisableDCache();
	SCB_DisableICache();
#endif

#if CONFIG_CPU_HAS_ARM_MPU || CONFIG_CPU_HAS_NXP_MPU
	z_arm_clear_arm_mpu_config();
#endif

#if defined(CONFIG_BUILTIN_STACK_GUARD) && \
    defined(CONFIG_CPU_CORTEX_M_HAS_SPLIM)
	/* Reset limit registers to avoid inflicting stack overflow on image
	 * being booted.
	 */
	__set_PSPLIM(0);
	__set_MSPLIM(0);
#endif

#else
	irq_lock();
#endif /* CONFIG_MCUBOOT_CLEANUP_ARM_CORE */

#ifdef CONFIG_BOOT_INTR_VEC_RELOC
#if defined(CONFIG_SW_VECTOR_RELAY)
	_vector_table_pointer = vt;
#ifdef CONFIG_CPU_CORTEX_M_HAS_VTOR
	SCB->VTOR = (uint32_t)__vector_relay_table;
#endif
#elif defined(CONFIG_CPU_CORTEX_M_HAS_VTOR)
	SCB->VTOR = (uint32_t)vt;
#endif /* CONFIG_SW_VECTOR_RELAY */
#else /* CONFIG_BOOT_INTR_VEC_RELOC */
#if defined(CONFIG_CPU_CORTEX_M_HAS_VTOR) && defined(CONFIG_SW_VECTOR_RELAY)
	_vector_table_pointer = _vector_start;
	SCB->VTOR = (uint32_t)__vector_relay_table;
#endif
#endif /* CONFIG_BOOT_INTR_VEC_RELOC */

	__set_MSP(msp);
#if CONFIG_MCUBOOT_CLEANUP_ARM_CORE
	__set_CONTROL(0x00); /* application will configures core on its own */
	__ISB();
#endif
	((void (*)(void))pc)();
}
```
